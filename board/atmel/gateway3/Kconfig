## board/atmel/gateway3/Kconfig
```kconfig
if TARGET_GATEWAY3

config SYS_CPU
	string
	default "armv7"

config SYS_BOARD
	string
	default "gateway3"

config SYS_VENDOR
	string
	default "atmel"

config SYS_SOC
	string
	default "at91"

config SYS_CONFIG_NAME
	string
	default "gateway3"

endif
```

## configs/gateway3_spiflash_defconfig
```kconfig
CONFIG_ARM=y
CONFIG_ARCH_AT91=y
CONFIG_TARGET_GATEWAY3=y
CONFIG_SPL=n
CONFIG_SYS_EXTRA_OPTIONS="SAMA5D3,SYS_USE_SERIALFLASH"
CONFIG_SYS_NO_FLASH=y
CONFIG_HUSH_PARSER=y
CONFIG_CMD_BOOTZ=y
CONFIG_CMD_IMI=y
# CONFIG_CMD_LOADS is not set
CONFIG_CMD_MMC=n
CONFIG_CMD_SF=y
CONFIG_CMD_USB=n
# CONFIG_CMD_FPGA is not set
CONFIG_CMD_DHCP=y
CONFIG_CMD_MII=y
CONFIG_CMD_PING=y
CONFIG_CMD_FAT=n
CONFIG_SPI_FLASH=y
CONFIG_SPI_FLASH_ATMEL=y
CONFIG_USB=n
CONFIG_USB_GADGET=n
CONFIG_USB_GADGET_ATMEL_USBA=n
CONFIG_OF_LIBFDT=y
CONFIG_CMD_MTDPARTS=y
CONFIG_MTD_DEVICE=y
CONFIG_MTD_PARTITIONS=y
CONFIG_RBTREE=y
CONFIG_LZO=y
CONFIG_CMD_UBI=y
CONFIG_CMD_UBIFS=y
CONFIG_CMD_BOOTM=n
```
